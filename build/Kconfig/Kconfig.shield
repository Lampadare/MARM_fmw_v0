## build/Kconfig/Kconfig.shield
```kconfig
osource "/Users/Martin/Desktop/WORK/HBR/Masters/MARM_fmw_v0/boards/shields/*/Kconfig.shield"
osource "/opt/nordic/ncs/v2.6.1/nrf/boards/shields/*/Kconfig.shield"
```

## build/Kconfig/Kconfig.shield.defconfig
```kconfig
osource "/Users/Martin/Desktop/WORK/HBR/Masters/MARM_fmw_v0/boards/shields/*/Kconfig.defconfig"
osource "/opt/nordic/ncs/v2.6.1/nrf/boards/shields/*/Kconfig.defconfig"
```
